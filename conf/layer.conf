## conf/layer.conf
```bitbake
# We have a conf and classes directory, add to BBPATH
BBPATH .= ":${LAYERDIR}"

# We have recipes-* directories, add to BBFILES
BBFILES += "${LAYERDIR}/recipes-*/*/*.bb \
            ${LAYERDIR}/recipes-*/*/*.bbappend"

BBFILE_COLLECTIONS += "meta-nbtscan"
BBFILE_PATTERN_meta-nbtscan = "^${LAYERDIR}/"
BBFILE_PRIORITY_meta-nbtscan = "6"

LAYERDEPENDS_meta-nbtscan = "core"
LAYERSERIES_COMPAT_meta-nbtscan = "dunfell gatesgarth hardknott"
```
